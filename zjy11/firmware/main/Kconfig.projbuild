## zjy11/firmware/main/Kconfig.projbuild
```kconfig
menu "zjy11 配置"

config ZJY11_GATEWAY_URL
    string "网关地址（例如 http://192.168.42.42:8111）"
    default "http://192.168.1.100:8111"
    help
        必须是局域网地址，不要用 127.0.0.1 或 localhost。

config ZJY11_DEVICE_TOKEN
    string "网关设备令牌"
    default ""
    help
        网关访问令牌，不是模型 API Key。模型密钥只保存在电脑端。

config ZJY11_WIFI_SSID
    string "Wi-Fi 名称（2.4 GHz）"
    default ""

config ZJY11_WIFI_PASSWORD
    string "Wi-Fi 密码"
    default ""

endmenu
```

## zjy11/firmware/sdkconfig.defaults
```kconfig
# 板级默认配置：ESP32-S3-Touch-LCD-1.85B
#
# 这些值必须与硬件一致，否则会出现「能用但浪费一半 Flash」
# 或「PSRAM 申请失败」这类难排查问题。
# 依据：官方规格 16MB Flash + 8MB PSRAM（ESP32-S3R8）。

# 固件目标
CONFIG_IDF_TARGET="esp32s3"

# 16MB Flash（默认是 2MB，必须改）
CONFIG_ESPTOOLPY_FLASHSIZE_16MB=y
CONFIG_ESPTOOLPY_FLASHSIZE="16MB"

# 8MB PSRAM（ESP32-S3R8 为八线 PSRAM）
CONFIG_SPIRAM=y
CONFIG_SPIRAM_MODE_OCT=y
CONFIG_SPIRAM_SPEED_80M=y
CONFIG_SPIRAM_USE_MALLOC=y

# 中断看门狗：第一版串口读阻塞时间较长，放宽避免误复位
CONFIG_ESP_TASK_WDT_TIMEOUT_S=10

# 控制台输出走 USB Serial/JTAG（Type-C 直连，无需额外接线）
CONFIG_ESP_CONSOLE_USB_SERIAL_JTAG=y

# 中文字体：LVGL 9 内置思源黑体简体，启用 16px 用于正文
CONFIG_LV_FONT_SOURCE_HAN_SANS_SC_16_CJK=y
CONFIG_LV_FONT_SOURCE_HAN_SANS_SC_14_CJK=y

# 分区表：中文字库让固件超过 1MB，用 16MB Flash 的单应用大分区
CONFIG_PARTITION_TABLE_CUSTOM=y
CONFIG_PARTITION_TABLE_CUSTOM_FILENAME="partitions.csv"
CONFIG_PARTITION_TABLE_FILENAME="partitions.csv"

# 诊断用：英文对比字体
CONFIG_LV_FONT_MONTSERRAT_20=y
CONFIG_LV_FONT_MONTSERRAT_28=y
```

## zjy13/firmware/main/Kconfig.projbuild
```kconfig
menu "zjy13 语音项目"

    config APP_WIFI_SSID
        string "Wi-Fi SSID（必须 2.4GHz）"
        default ""
        help
            板子只支持 2.4GHz。配成 5GHz 的 SSID 会报 reason 201（找不到 AP）。

    config APP_WIFI_PASSWORD
        string "Wi-Fi 密码"
        default ""
        help
            开放网络留空。

    config APP_SERVER_HOST
        string "服务端地址（电脑的局域网 IP）"
        default "192.168.1.100"
        help
            运行 server.ws.server 的那台电脑的 IP。
            注意服务端要用 --host 0.0.0.0 启动，默认的 127.0.0.1 无法被板子访问。

    config APP_SERVER_PORT
        int "服务端端口"
        default 8765

    config APP_DEVICE_ID
        string "设备标识"
        default "esp32s3-01"
        help
            服务端日志里用于区分多台设备。

    config APP_DEVICE_TOKEN
        string "设备访问令牌（可留空）"
        default ""
        help
            服务端用 --token 启动时必填，否则留空。

    config APP_UI_LCD_ENABLE
        bool "启用 LCD 显示"
        default n
        help
            本项目主要复用板子里已有的显示固件。
            打开需要额外引入 ST77916 驱动组件，
            且中文显示需要字库。联调阶段建议关闭，
            用串口日志 + 屏幕已有 UI 即可。

endmenu
```

## zjy13/firmware/sdkconfig.defaults
```kconfig
# ===== 目标芯片 =====
CONFIG_IDF_TARGET="esp32s3"

# ===== Flash =====
# 16MB，DIO，80MHz（与原厂固件一致）
CONFIG_ESPTOOLPY_FLASHSIZE_16MB=y
CONFIG_ESPTOOLPY_FLASHSIZE="16MB"
CONFIG_ESPTOOLPY_FLASHMODE_DIO=y
CONFIG_ESPTOOLPY_FLASHFREQ_80M=y

# ===== 分区表 =====
CONFIG_PARTITION_TABLE_CUSTOM=y
CONFIG_PARTITION_TABLE_CUSTOM_FILENAME="partitions.csv"

# ===== PSRAM =====
# 8MB Octal PSRAM。帧缓冲与音频缓冲都放这里。
CONFIG_SPIRAM=y
CONFIG_SPIRAM_MODE_OCT=y
CONFIG_SPIRAM_SPEED_80M=y
CONFIG_SPIRAM_USE_MALLOC=y
CONFIG_SPIRAM_MALLOC_ALWAYSINTERNAL=16384
CONFIG_SPIRAM_TRY_ALLOCATE_WIFI_LWIP=y

# ===== FreeRTOS =====
CONFIG_FREERTOS_HZ=1000
CONFIG_FREERTOS_UNICORE=n

# ===== 日志 =====
CONFIG_LOG_DEFAULT_LEVEL_INFO=y
CONFIG_LOG_MAXIMUM_LEVEL_INFO=y

# ===== 主任务栈 =====
CONFIG_ESP_MAIN_TASK_STACK_SIZE=8192

# ===== 项目自定义 =====
CONFIG_APP_SERVER_PORT=8765
CONFIG_APP_DEVICE_ID="esp32s3-01"
CONFIG_APP_UI_LCD_ENABLE=n

# ===== WebSocket =====
CONFIG_WS_TRANSPORT=y
```
